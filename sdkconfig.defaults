## sdkconfig.defaults
```kconfig
CONFIG_PARTITION_TABLE_CUSTOM=y
CONFIG_PARTITION_TABLE_CUSTOM_FILENAME="partitions.csv"
CONFIG_PARTITION_TABLE_FILENAME="partitions.csv"
CONFIG_ESPTOOLPY_FLASHSIZE_4MB=y
CONFIG_ESP_WIFI_SSID="Pixel do Edu"
CONFIG_ESP_WIFI_PASSWORD="passwordASE"
CONFIG_ESP_WIFI_AUTH_WPA2_PSK=y
CONFIG_MQTT_TRANSPORT_SSL=y
```
